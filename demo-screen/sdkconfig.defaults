## demo-screen/sdkconfig.defaults
```kconfig
CONFIG_IDF_TARGET="esp32s3"

# Flash 16MB（esptool 实测），QIO 80MHz
CONFIG_ESPTOOLPY_FLASHSIZE_16MB=y
CONFIG_ESPTOOLPY_FLASHMODE_QIO=y
CONFIG_ESPTOOLPY_FLASHFREQ_80M=y

# 8MB Octal PSRAM（esptool 实测 Embedded PSRAM 8MB）
CONFIG_SPIRAM=y
CONFIG_SPIRAM_MODE_OCT=y
CONFIG_SPIRAM_SPEED_80M=y

# CPU 240MHz
CONFIG_ESP_DEFAULT_CPU_FREQ_MHZ_240=y

# 日志级别 DEBUG，方便看初始化细节
CONFIG_LOG_DEFAULT_LEVEL_DEBUG=y
CONFIG_LOG_MAXIMUM_LEVEL_DEBUG=y

CONFIG_ESP_MAIN_TASK_STACK_SIZE=4096
```

## firmware/sdkconfig.defaults.c3
```kconfig
# 上千 AI Passport 看板固件 · ESP32-C3 默认配置
#
# 单独一份（不叠加 sdkconfig.defaults），因为那块是 S3 专用：
# 16MB / QIO / Octal PSRAM / 双 OTA 分区，在 C3 上会直接配置失败。
#
# 构建命令见 toolchain/build-firmware-c3.sh：
#   idf.py -B build-c3 -DIDF_TARGET=esp32c3 \
#          -DSDKCONFIG=sdkconfig.c3 \
#          -DSDKCONFIG_DEFAULTS=sdkconfig.defaults.c3 build

# ---- 目标芯片 ----
CONFIG_IDF_TARGET="esp32c3"

# ---- Flash：8MB，DIO 80MHz（板上是 XMC 颗粒，先用最保守的 DIO）----
CONFIG_ESPTOOLPY_FLASHSIZE_8MB=y
# 离线 merge-bin 需要确定值，不能留 detect
CONFIG_ESPTOOLPY_HEADER_FLASHSIZE_UPDATE=n
CONFIG_ESPTOOLPY_FLASHMODE_DIO=y
CONFIG_ESPTOOLPY_FLASHFREQ_80M=y

# ---- 分区表：沿用板上原厂布局（factory 0x7f0000，无 OTA）----
CONFIG_PARTITION_TABLE_CUSTOM=y
CONFIG_PARTITION_TABLE_CUSTOM_FILENAME="partitions_c3.csv"
CONFIG_PARTITION_TABLE_OFFSET=0x8000

# ---- 串口：这块板只有 USB-Serial/JTAG（VID 303A / PID 1001）----
CONFIG_ESP_CONSOLE_USB_SERIAL_JTAG=y
CONFIG_ESP_CONSOLE_SECONDARY_NONE=y

# ---- PSRAM：C3 没有 ----
# CONFIG_SPIRAM is not set

# ---- CPU 160MHz（C3 上限）----
CONFIG_ESP_DEFAULT_CPU_FREQ_MHZ_160=y

# ---- 编译优化：体积优先（C3 的 SRAM/IRAM 都要抠）----
CONFIG_COMPILER_OPTIMIZATION_SIZE=y
CONFIG_COMPILER_CXX_EXCEPTIONS=n
CONFIG_COMPILER_CXX_RTTI=n

# ---- 主任务栈 ----
CONFIG_ESP_MAIN_TASK_STACK_SIZE=8192

# ---- FreeRTOS tick 1000Hz，LVGL 动画更顺 ----
CONFIG_FREERTOS_HZ=1000

# ---- 日志 ----
CONFIG_LOG_DEFAULT_LEVEL_INFO=y
CONFIG_LOG_MAXIMUM_LEVEL_DEBUG=y

# ---- WiFi（WB_BLE_ONLY 默认不启动，但组件仍参与链接）----
CONFIG_ESP_WIFI_STATIC_RX_BUFFER_NUM=4
CONFIG_ESP_WIFI_DYNAMIC_RX_BUFFER_NUM=8
CONFIG_ESP_WIFI_DYNAMIC_TX_BUFFER_NUM=8
CONFIG_ESP_WIFI_AMPDU_TX_ENABLED=y
CONFIG_ESP_WIFI_AMPDU_RX_ENABLED=y

# ---- Bluetooth LE / NimBLE（只做被连的一方）----
CONFIG_BT_ENABLED=y
CONFIG_BT_NIMBLE_ENABLED=y
CONFIG_BT_NIMBLE_ROLE_CENTRAL=n
CONFIG_BT_NIMBLE_ROLE_PERIPHERAL=y
CONFIG_BT_NIMBLE_ROLE_BROADCASTER=y
CONFIG_BT_NIMBLE_ROLE_OBSERVER=n
CONFIG_BT_NIMBLE_MAX_CONNECTIONS=1
CONFIG_BT_NIMBLE_HOST_BASED_PRIVACY=n
CONFIG_BT_NIMBLE_NVS_PERSIST=n
# BLE controller 代码放 flash，给 C3 的 DRAM 腾空间
CONFIG_BT_CTRL_RUN_IN_FLASH_ONLY=y
# 日志降到 WARNING：notify 级别日志会抢串口与 CPU
CONFIG_BT_NIMBLE_LOG_LEVEL_WARNING=y
CONFIG_BT_NIMBLE_LOG_LEVEL=2

# ---- LVGL（与 S3 保持同一套裁剪）----
CONFIG_LV_COLOR_DEPTH_16=y
CONFIG_LV_OS_NONE=y
CONFIG_LV_USE_CLIB_MALLOC=y
CONFIG_LV_USE_CLIB_STRING=y
CONFIG_LV_USE_CLIB_SPRINTF=y

# 关键：ST7789 走 SPI 时按高字节优先收 RGB565，而 LVGL 内存是小端。
# 不设这一项，board_display 里的 LV_COLOR_FORMAT_RGB565_SWAPPED 会用错，
# 抗锯齿文字边缘会冒出彩色噪点（看起来像花屏）。
CONFIG_LV_DRAW_SW_SUPPORT_RGB565_SWAPPED=y

# C3 无 PSRAM，帧缓冲只有 12 行单缓冲（见 board_display.cpp）—— 这里
# 必须保持 PARTIAL 渲染模式（默认值），不能开 FULL。
CONFIG_LV_USE_ANIMIMG=n
CONFIG_LV_USE_CALENDAR=n
CONFIG_LV_USE_CHART=n
CONFIG_LV_USE_COLORWHEEL=n
CONFIG_LV_USE_KEYBOARD=n
CONFIG_LV_USE_LIST=n
CONFIG_LV_USE_MENU=n
CONFIG_LV_USE_METER=n
CONFIG_LV_USE_SPAN=n
CONFIG_LV_USE_SPINBOX=n
CONFIG_LV_USE_SPINNER=n
CONFIG_LV_USE_TABLE=n
CONFIG_LV_USE_TABVIEW=n
CONFIG_LV_USE_TILEVIEW=n
CONFIG_LV_USE_WIN=n

CONFIG_LV_FONT_MONTSERRAT_10=y
CONFIG_LV_FONT_MONTSERRAT_12=y
CONFIG_LV_FONT_MONTSERRAT_14=y
CONFIG_LV_FONT_MONTSERRAT_20=y
CONFIG_LV_FONT_MONTSERRAT_28=y
CONFIG_LV_FONT_DEFAULT_MONTSERRAT_14=y
```

## probe-spk/sdkconfig.defaults
```kconfig
CONFIG_IDF_TARGET="esp32s3"
CONFIG_ESPTOOLPY_FLASHSIZE_16MB=y
CONFIG_SPIRAM=y
CONFIG_SPIRAM_MODE_OCT=y
CONFIG_SPIRAM_SPEED_80M=y
CONFIG_ESP_DEFAULT_CPU_FREQ_MHZ_240=y
CONFIG_LOG_DEFAULT_LEVEL_INFO=y
```
